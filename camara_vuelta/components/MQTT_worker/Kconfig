## camara_vuelta/components/MQTT_worker/Kconfig
```kconfig
menu "Provisioning configuration"

    config TEMPLATE_NAME
        string "The name of the Thing template to be used"
        default "cameraTemplate"
endmenu

menu "MQTT Worker configuration"
    
    config AWS_ENDPOINT
        string "The AWS endpoint to be used"
        default  ""
endmenu

menu "S3 Uploader"

    config S3_DEFAULT_PART_SIZE
        int "Default multipart part size (bytes)"
        default 8388608
        range 524288 67108864
        help
            Default size (in bytes) used for multipart uploads when init_info omits part_size.
            8388608 = 8 MiB.

    config S3_HTTP_TIMEOUT_MS
        int "HTTP timeout per part PUT (ms)"
        default 20000
        range 1000 120000
        help
            Timeout used by esp_http_client for each part upload request.

    config S3_HTTP_PUT_RETRIES
        int "HTTP PUT retries per part"
        default 3
        range 0 10
        help
            Number of retry attempts for each part upload.

    menu "Buffer / ID length limits"

        config S3_MAX_TOPIC_LEN
            int "Max MQTT topic length"
            default 256
            range 64 1024

        config S3_MAX_THING_NAME
            int "Max thingName length"
            default 96
            range 16 256

        config S3_MAX_RECORDING_ID
            int "Max recordingId length"
            default 64
            range 16 256

        config S3_MAX_UPLOAD_ID
            int "Max uploadId length"
            default 128
            range 16 512

        config S3_MAX_PATH_LEN
            int "Max file path length"
            default 256
            range 64 512

        config S3_MAX_BUCKET_LEN
            int "Max S3 bucket name length"
            default 128
            range 16 256

        config S3_MAX_KEY_LEN
            int "Max S3 key length"
            default 256
            range 32 1024

        config S3_MAX_URL_LEN
            int "Max presigned URL length"
            default 2048
            range 256 4096

        config S3_MAX_ETAG_LEN
            int "Max ETag header length"
            default 80
            range 32 256

    endmenu

endmenu
```

## camara_vuelta/components/NVS_manager/Kconfig
```kconfig
menu "NVS Manager"
  config OTA_REC_MAGIC
    int "Magic number to check NVS record integrity"
    default 1330921810
  
endmenu
```

## camara_vuelta/components/OTA_manager/Kconfig
```kconfig
menu "OTA Manager"

  config OTA_CHUNK_COUNT
    int "Amount of OTA chunks allocated by the OTA Manager"
    range 1 4
    default 4
  
  config OTA_CHUNK_SIZE
    int "Size of each OTA chunk in bytes"
    range 256 131072
    default 4096

endmenu
```

## camara_vuelta/components/SD_manager/Kconfig
```kconfig
menu "SD Card Manager"

  config SD_CARD_MOUNT_POINT
  string "VFS Mountpoint for SD Card"
  default "/sdcard"

  config SD_CARD_DEFAULT_MIN_FREE_KB
    int "Minimum free space in SD card on mount, in Kilo Bytes"
    default  1
    help 
      A small number is recommended here as default, if you need bigger values configure them via the configuration MQTT topic.

  menu "GPIOs"
      config PIN_CLK
      int "CLK"
      default 43

      config PIN_CMD
      int "CMD"
      default  44
    
      config PIN_D0
      int "D0"
      default  39
    
      config PIN_D1
      int "1"
      default  40
    
      config PIN_D2
      int "D2"
      default  41

      config PIN_D3
      int "D3"
      default  42      
  endmenu

  menu "SDMMC Mount Configurations"
      config FORMAT_IF_MOUNT_FAILED
        bool "Format the filesystem if mounting fails"
        default false
      
      config MAX_OPEN_FILES
        int "Maximum amount of open files"
        default 5

      config ALLOCATION_UNIT_SIZE
        int "Allocation unit size when formatting"
        default 65536
        help
          Must be a power of 2, between sector size and 128 * sector size. For SD cards, sector size is always 512 bytes
  endmenu

  menu "SDMMC Host Configurations"
      config SDMMC_MAX_SPEED
      int "SDMMC max speed in kHz"
      range 20000 100000
      default  40000

      config SDMMC_SLOT_BUS_WIDTH
      int "SDMMC bus width"
      range 1 4
      default  4
  endmenu
endmenu
```

## camara_vuelta/components/video_manager/Kconfig
```kconfig
menu "Video Manager"

  menu "Staging Buffer Configurations"
      config VMAN_STAGE_SIZE_KB
        int "Size of the staging buffers (in kB)"
        range 1024 4096
        default 3072
      
      config VMAN_STAGE_LIMIT
        int "Occupancy limit for staging buffers before flushing (in %)"
        range 50 90
        default 70
      
      config VMAN_STAGE_ALIGNMENT
        int "Bit alignment for stage writes"
        default 65536
  endmenu

endmenu
```

## camara_vuelta/main/Kconfig.projbuild
```kconfig
menu "VueltaCam configuration"

config PROJ_BASE_NAME
    string "Name of the project"
    default "yxcam"
    help
        This name should match the CloudFormation stack base name in AWS.

config AWS_ENDPOINT
    string "The AWS IoT Core endpoint to be used"
    default  ""

menu "AWS IoT Certificates"

config AWS_IOT_CERT_PEM_PATH
    string "Device certificate PEM path"
    default ""
    help
        Absolute path to device certificate PEM file. Not stored in firmware; only used at build time.

config AWS_IOT_PRIV_KEY_PATH
    string "Device private key path"
    default ""
    help
        Absolute path to device private key PEM file. Not stored in firmware; only used at build time.

config AWS_IOT_ROOT_CA_PATH
    string "Root CA PEM path"
    default ""
    help
        Absolute path to root CA PEM file. Not stored in firmware; only used at build time.

endmenu

choice PROJ_ENV_CHOICE
    prompt "Build environment"
    default PROJ_ENV_DEV
    help
      Select the target environment for this firmware build.
      Code can check CONFIG_PROJ_ENV_DEV/TEST/PROD or the
      derived CONFIG_PROJ_ENV_NAME string.
config PROJ_ENV_DEV
    bool "dev"
config PROJ_ENV_TEST
    bool "test"
config PROJ_ENV_PROD
    bool "prod"
endchoice

config PROJ_ENV_NAME
    string "Selected environment (derived)"
    default "dev"  if PROJ_ENV_DEV
    default "test" if PROJ_ENV_TEST
    default "prod" if PROJ_ENV_PROD
    help
      Convenience string matching the selected environment.

endmenu
```

## camara_vuelta/sdkconfig.defaults
```kconfig
##################################################
## PROJECT CONFIGURATION
#
CONFIG_IDF_TARGET="esp32p4"
CONFIG_IDF_TARGET_ESP32P4=y
CONFIG_IDF_EXPERIMENTAL_FEATURES=y
CONFIG_ESP_SYSTEM_PANIC_PRINT_HALT=y

##################################################
## FREERTOS
#
FREERTOS_TIMER_TASK_STACK_DEPTH=4096

##################################################
## OTA
#
CONFIG_BOOTLOADER_APP_ROLLBACK_ENABLE=y

##################################################
## PSRAM
#
CONFIG_SPIRAM=y
CONFIG_SPIRAM_USE_MALLOC=y
CONFIG_SPIRAM_SPEED_200M=y

##################################################
## FLASH CONFIGURATION
#
CONFIG_SPI_FLASH_SUPPORT_GD_CHIP=y
CONFIG_ESPTOOLPY_FLASHSIZE_16MB=y
CONFIG_ESPTOOLPY_FLASHSIZE="16MB"
CONFIG_PARTITION_TABLE_CUSTOM=y
CONFIG_PARTITION_TABLE_FILENAME="partitions.csv"

##################################################
## MQTT
#
CONFIG_MQTT_USE_CUSTOM_CONFIG=y
CONFIG_MQTT_TASK_STACK_SIZE=8192

##################################################
## LOGGING
#
CONFIG_LOG_VERSION_2=y
CONFIG_LOG_DEFAULT_LEVEL_INFO=y
CONFIG_LOG_MAXIMUM_LEVEL_VERBOSE=y

##################################################
## CAMERA SENSOR
#
CONFIG_CAMERA_OV5647=y
CONFIG_CAMERA_OV5647_MIPI_IF_FORMAT_INDEX_DEFAULT=4
CONFIG_CAMERA_OV5647_MIPI_RAW10_1280X960_BINNING_45FPS=y

##################################################
## FATFS CONFIG
#
CONFIG_FATFS_DONT_TRUST_FREE_CLUSTER_CNT=1
CONFIG_FATFS_DONT_TRUST_LAST_ALLOC=1
CONFIG_FATFS_LFN_HEAP=y
CONFIG_FATFS_MAX_LFN=255

##################################################
## ETHERNET
#
CONFIG_ETH_IRAM_OPTIMIZATION=y

CONFIG_ETH_ENABLED=y
CONFIG_ETH_USE_ESP32_EMAC=y
CONFIG_ETH_PHY_INTERFACE_RMII=y
CONFIG_ETH_DMA_RX_BUFFER_NUM=20
CONFIG_ETH_DMA_TX_BUFFER_NUM=20
CONFIG_ETH_DMA_BUFFER_SIZE=1024

##################################################
## NETWORK SPEED TWEAKS
#
CONFIG_MBEDTLS_ASYMMETRIC_CONTENT_LEN=y
CONFIG_MBEDTLS_SSL_IN_CONTENT_LEN=16384
CONFIG_MBEDTLS_SSL_OUT_CONTENT_LEN=16384
CONFIG_LWIP_TCP_SND_BUF_DEFAULT=65535
CONFIG_LWIP_TCP_WND_DEFAULT=65535
CONFIG_LWIP_TCP_MSS=1460
CONFIG_LWIP_IRAM_OPTIMIZATION=y
CONFIG_MBEDTLS_HARDWARE_AES=y
CONFIG_MBEDTLS_HARDWARE_SHA=y
CONFIG_SPIRAM_TRY_ALLOCATE_WIFI_LWIP=y
CONFIG_LWIP_WND_SCALE=y
CONFIG_LWIP_TCP_RCV_SCALE=1
```

## full_provision/components/Ethernet_manager/Kconfig
```kconfig
menu "Ethernet Manager"
  menu "GPIOs"
      config ETH_TXD0_GPIO
      int "TXD0"
      default  34

      config ETH_TXD1_GPIO
      int "TXD1"
      default  35
    
      config ETH_RXD0_GPIO
      int "RXD0"
      default  30
    
      config ETH_RXD1_GPIO
      int "RXD1"
      default  29
    
      config ETH_TXEN_GPIO
      int "TXEN"
      default  49

      config ETH_CRS_DV_GPIO
      int "CRSDV"
      default  28

      config ETH_REF_CLK_GPIO
      int "REFCLK"
      default  50

      config ETH_MDC_GPIO
      int "MDC"
      default  31

      config ETH_MDIO_GPIO
      int "MDIO"
      default  52

      config ETH_RST_GPIO
      int "RST"
      default  51
      
  endmenu
endmenu
```

## full_provision/components/MQTT_worker/Kconfig
```kconfig
menu "Provisioning configuration"

    config TEMPLATE_NAME
        string "The name of the Thing template to be used"
        default "TestTemplate"
endmenu

menu "MQTT Worker configuration"
    
    config AWS_ENDPOINT
        string "The AWS endpoint to be used"
        default  "a21g6vkmxju0d9-ats.iot.sa-east-1.amazonaws.com"
endmenu
```

## full_provision/components/WiFi_manager/Kconfig
```kconfig
menu "WiFi Manager configuration"
  config MAX_RETRY
    int "Maximum amount of retries for WiFi connection"
    default 10
endmenu
```

## full_provision/components/provision_claimer/Kconfig
```kconfig
menu "Provisioning configuration"

    config TEMPLATE_NAME
        string "The name of the Thing template to be used"
        default "TestTemplate"
endmenu
```
